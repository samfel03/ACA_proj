/ {
	amba_pl: amba_pl {
		ranges;
		compatible = "simple-bus";
		#address-cells = <1>;
		#size-cells = <1>;
		add_0: add@40000000 {
			compatible = "xlnx,add-2.0";
			xlnx,ii = "x";
			xlnx,s-axi-crtls-addr-width = <6>;
			xlnx,machine = <64>;
			xlnx,rable = <0>;
			xlnx,ip-name = "add";
			reg = <0x40000000 0x10000>;
			clocks = <&clkc 15>;
			xlnx,clk-period = <10>;
			xlnx,s-axi-crtls-data-width = <32>;
			xlnx,edk-iptype = "PERIPHERAL";
			status = "okay";
			clock-names = "ap_clk";
			xlnx,combinational = <1>;
			xlnx,latency = <0>;
			xlnx,name = "add_0";
		};
	};
};
